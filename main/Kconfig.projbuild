## main/Kconfig.projbuild
```kconfig
menu "Perceptron"

    config PERCEPTRON_NODE_NAME
        string "ROS node name"
        default "perceptron"

    config PERCEPTRON_NODE_NAMESPACE
        string "ROS namespace"
        default "perceptron"

    config PERCEPTRON_BLE_DEVICE_NAME
        string "BLE device name"
        default "Perceptron"

    config PERCEPTRON_CONTROLLER_PERIOD_MS
        int "Controller loop period (ms)"
        default 12
        range 5 50
        help
            Period of the PID control loop in milliseconds.
            12ms = ~80Hz.

    config PERCEPTRON_ROBOT_RADIUS_MM
        int "Robot radius (mm)"
        default 100
        range 10 500
        help
            Distance from robot center to wheel contact point in mm.

    config PERCEPTRON_WHEEL_RADIUS_MM
        int "Wheel radius (mm)"
        default 58
        range 5 200
        help
            Wheel radius in mm, used to convert m/s to RPS.

    config PERCEPTRON_PID_ENABLED
        bool "Enable PID motor speed control (requires encoders)"
        default y
        help
            When enabled, motors use closed-loop PID with encoder feedback.
            When disabled, cmd_vel maps directly to PWM duty (open-loop).

    config PERCEPTRON_ENCODER_CPR
        int "Encoder counts per revolution"
        depends on PERCEPTRON_PID_ENABLED
        default 4200
        range 100 65535
        help
            Full quadrature counts per revolution (PPR * 4).

    config PERCEPTRON_CMD_VEL_TIMEOUT_MS
        int "cmd_vel timeout (ms)"
        default 500
        range 100 5000
        help
            Stop motors if no cmd_vel message is received within
            this timeout.

    config PERCEPTRON_WEAPON_BIDIRECTIONAL
        bool "Weapon ESC bidirectional mode"
        default y
        help
            When enabled, the weapon ESC runs in bidirectional mode
            (center=stop, forward/reverse). Throttle range per direction
            is halved. When disabled, full throttle range is used for
            one direction (maximum speed).

    config PERCEPTRON_WEAPON_ARM_DELAY_MS
        int "Weapon arm delay after E-STOP release (ms)"
        default 3000
        range 0 10000
        help
            Safety delay before the weapon is armed after releasing
            the E-STOP.

    config PERCEPTRON_BATTERY_PUB_PERIOD_MS
        int "Battery voltage publish period (ms)"
        default 5000
        range 50 60000
        help
            How often the battery voltage is published over ROS.

    config PERCEPTRON_TIME_RESYNC_PERIOD_MS
        int "Time resync period (ms)"
        default 30000
        range 5000 300000
        help
            How often to resynchronize the clock with the micro-ROS
            agent.

endmenu
```

## sdkconfig.defaults
```kconfig
CONFIG_ESP_MAIN_TASK_STACK_SIZE=3000
CONFIG_ESP_TASK_WDT=n
CONFIG_FREERTOS_HZ=1000

# Bluetooth
CONFIG_BT_ENABLED=y
CONFIG_BT_NIMBLE_ENABLED=y

# BLE throughput optimizations
CONFIG_BT_NIMBLE_ATT_PREFERRED_MTU=247
CONFIG_BT_NIMBLE_ACL_BUF_SIZE=255
CONFIG_BT_NIMBLE_ACL_BUF_COUNT=12
CONFIG_BT_NIMBLE_MSYS_1_BLOCK_COUNT=24

# Console over UART (USB Serial/JTAG disabled to free GPIO12/13 -> our weapon pin)
CONFIG_ESP_CONSOLE_UART_DEFAULT=y
CONFIG_ESP_CONSOLE_SECONDARY_NONE=y
CONFIG_USJ_ENABLE_USB_SERIAL_JTAG=n

# CONFIG_LOG_DEFAULT_LEVEL_INFO=y
CONFIG_LOG_DEFAULT_LEVEL_WARN=y
CONFIG_BT_NIMBLE_LOG_LEVEL_WARNING=y

# micro-ROS
CONFIG_MICRO_ROS_ESP_XRCE_DDS_MIDDLEWARE=y
CONFIG_MICRO_ROS_ESP_UART_TRANSPORT=y

# Perceptron
CONFIG_PERCEPTRON_BLE_DEVICE_NAME="Perceptron"
CONFIG_PERCEPTRON_PID_ENABLED=y
```
